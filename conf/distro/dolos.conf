## conf/distro/dolos.conf
```bitbake
require conf/distro/include/poky-floating-revisions.inc
require conf/distro/poky.conf

DISTRO = "dolos"
DISTRO_NAME = "Dolos (by Crow Solutions)"
DISTRO_VERSION = "1.0.1"
DISTRO_CODENAME = "emilia"

MAINTAINER = "Johnny Vestergaard <jkv@crowsolutions.dk>"

KERNEL_MODULE_AUTOLOAD += " nls-utf8 nls-iso8859-1 nls-cp437"
MACHINE_ESSENTIAL_EXTRA_RDEPENDS += " kernel-module-nls-iso8859-1 kernel-module-nls-cp437 kernel-module-nls-utf8"
# why does this not work?
```

## conf/layer.conf
```bitbake
# We have a conf and classes directory, add to BBPATH
BBPATH .= ":${LAYERDIR}"

# We have recipes-* directories, add to BBFILES
BBFILES += "${LAYERDIR}/recipes-*/*/*.bb \
	${LAYERDIR}/recipes-*/*/*.bbappend"

BBFILE_COLLECTIONS += "crow"
BBFILE_PATTERN_crow = "^${LAYERDIR}/"
BBFILE_PRIORITY_crow = "6"
```
